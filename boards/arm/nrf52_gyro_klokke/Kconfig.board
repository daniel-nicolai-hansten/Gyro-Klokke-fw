## boards/arm/nrf52_gyro_klokke/Kconfig.board
```kconfig
# nRF52840 Dongle NRF52840 board configuration

# Copyright (c) 2018 Nordic Semiconductor ASA
# SPDX-License-Identifier: Apache-2.0

config BOARD_nrf52_gyro_klokke
	bool "e73 minimal NRF52840"
	depends on SOC_NRF52840_QIAA
```
